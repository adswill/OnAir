// SPDX-License-Identifier: GPL-3.0-or-later
// Copyright (C) 2026 Kristijonas Adomaitis and OnAir contributors

// Iridium ACARS (issue #281): synthetic multi-frame ACARS (with parity and check bytes) through IDA frames, reassembly, SBD parse and the
// message layer: retransmissions, joined blocks, registration kinds, malformed and partial input, positions, the aircraft list.
// Everything here is generated by the builders of the code under test (no real Iridium recording): see iridium_acars.h.
#include "dect2/iridium/iridium_acars.h"
#include "dect2/iridium/iridium_frame.h"
#include "dect2/iridium/iridium_sbd.h"
#include <cmath>
#include <cstdio>
using namespace dect2;
#include "../common/test_util.h"

static IridiumFrame idaFrame(const std::vector<uint8_t>& payload, int ctr, bool more) {
    IridiumBurstBits b;
    b.bits = iridiumBuildIda(payload, ctr, more);
    return decodeIridiumBurst(b);
}

// packet bytes -> IDA frames -> assembler -> packets (all fragments 30 ms apart)
static std::vector<IridiumIdaPacket> viaFrames(IridiumIdaAssembler& as, const std::vector<uint8_t>& pk, bool down, double t0, int skip = -1) {
    std::vector<IridiumIdaPacket> out;
    const auto parts = iridiumSplitIda(pk);
    for (size_t i = 0; i < parts.size(); i++) {
        if ((int)i == skip) continue;
        const IridiumFrame f = idaFrame(parts[i], (int)(i % 8), i + 1 < parts.size());
        CHECK(f.ok && f.crcOk, "ida frame %zu: ok %d crc %d", i, f.ok, f.crcOk);
        for (auto& p : as.feed(f, down, 1626.2e6, t0 + 0.03 * (double)i, (uint64_t)(100 + i))) out.push_back(p);
    }
    return out;
}

static IridiumAcarsOutcome ingest(IridiumTelemetry& t, const std::vector<uint8_t>& pkBytes, bool down, double time, uint64_t* ser = nullptr) {
    IridiumIdaAssembler as;
    const auto v = viaFrames(as, pkBytes, down, time);
    CHECK(v.size() == 1, "one packet, got %zu", v.size());
    if (v.size() != 1) return IridiumAcarsOutcome::None;
    const IridiumSbd s = iridiumParseSbd(v[0].data, down);
    return iridiumAcarsIngest(t, v[0], s, 1700000000 + (int64_t)time, ser);
}

int main() {
    // ---- a long message in several fragments, parity and check bytes
    {
        IridiumAcarsBuild b;
        b.reg = "N893QS"; b.label = "H1"; b.blockId = '3'; b.parity = true; b.crc = true; b.ack = 'A';
        b.text = "#M1BPOSN43312W123174,EASON,215754,370,ARINCDIRECT FLIGHT PLAN F-PLN KSEA/KPDX ROUTE SEA OLM PDX FL370";
        const auto pk = iridiumBuildSbdAcarsEx(b);
        CHECK(pk.size() > 60, "long packet %zu bytes", pk.size());
        IridiumIdaAssembler as;
        const auto v = viaFrames(as, pk, true, 10.0);
        CHECK(v.size() == 1 && v[0].fragments >= 5 && v[0].tags.size() == (size_t)v[0].fragments, "reassembled %zu, fragments %d, tags %zu", v.size(), v.empty() ? 0 : v[0].fragments, v.empty() ? 0 : v[0].tags.size());
        CHECK(!v.empty() && v[0].data == pk, "packet bytes identical");
        const IridiumSbd s = iridiumParseSbd(v[0].data, true);
        CHECK(s.valid && s.acars.valid && s.acars.crc == 1 && s.acars.parity == 1, "crc %d parity %d", s.acars.crc, s.acars.parity);
        CHECK(s.acars.text == b.text && s.acars.reg == ".N893QS" && s.acars.label == "H1" && s.acars.blockId == '3' && s.acars.ack == 'A' && !s.acars.more, "fields '%s'", s.acars.text.c_str());
        IridiumTelemetry t;
        uint64_t ser = 0;
        CHECK(iridiumAcarsIngest(t, v[0], s, 1700000010, &ser) == IridiumAcarsOutcome::New && t.acars.size() == 1 && ser == t.acars[0].serial, "new message");
        const auto& m = t.acars[0];
        CHECK(m.reg == "N893QS" && m.regKind == 1 && m.crc == 1 && m.parity == 1 && m.downlink && !m.hasPos, "listed fields");
        CHECK(m.labelText == "" || !m.labelText.empty(), "label text is whatever the table has");
        CHECK(t.aircraft.size() == 1 && t.aircraft[0].reg == "N893QS" && t.aircraft[0].messages == 1 && !t.aircraft[0].hasPos, "aircraft listed, no position from a ground message");
    }
    // ---- without parity or check bytes: kept and marked
    {
        IridiumAcarsBuild b; b.reg = "N1"; b.text = "HELLO";
        IridiumTelemetry t;
        CHECK(ingest(t, iridiumBuildSbdAcarsEx(b), true, 1.0) == IridiumAcarsOutcome::New, "plain block listed");
        CHECK(t.acars.size() == 1 && t.acars[0].crc == 0 && t.acars[0].parity == 0 && t.acars[0].text == "HELLO", "plain: crc %d parity %d", t.acars[0].crc, t.acars[0].parity);
    }
    // ---- damaged blocks are listed and flagged, not dropped
    {
        IridiumAcarsBuild b; b.reg = "N2"; b.label = "Q0"; b.text = "ABCDEFGH"; b.parity = true; b.crc = true;
        auto pk = iridiumBuildSbdAcarsEx(b);
        auto bad = pk;
        bad[10 + 13 + 3] ^= 0x01;       // a text byte: parity wrong and check wrong
        IridiumTelemetry t;
        CHECK(ingest(t, bad, true, 1.0) == IridiumAcarsOutcome::New && t.acars.size() == 1, "damaged block listed");
        CHECK(t.acars[0].crc == 2 && t.acars[0].parity == 2 && t.acarsCrcBad == 1 && t.acarsParityBad == 1, "flags crc %d parity %d", t.acars[0].crc, t.acars[0].parity);
        auto badCrc = pk;
        badCrc[badCrc.size() - 3] ^= 0x10;   // only a check byte
        IridiumTelemetry t2;
        ingest(t2, badCrc, true, 1.0);
        CHECK(t2.acars.size() == 1 && t2.acars[0].crc == 2 && t2.acars[0].parity == 1 && t2.acars[0].text == "ABCDEFGH", "check byte damage: crc %d parity %d text '%s'", t2.acars[0].crc, t2.acars[0].parity, t2.acars[0].text.c_str());
    }
    // ---- malformed and partial input
    {
        IridiumTelemetry t;
        IridiumIdaPacket none;
        none.data = {0x76, 0x08, 0x20, 0, 0, 0, 0, 0x10, 5, 0x01, 0x01, '2', '.', 'N'};     // cut short
        const IridiumSbd s1 = iridiumParseSbd(none.data, true);
        CHECK(iridiumAcarsIngest(t, none, s1, 1) == IridiumAcarsOutcome::None && t.acars.empty(), "short ACARS ignored");
        none.data = {0x76, 0x08, 0x20, 0, 0, 0, 0, 0x10, 14, 0x01, 0x01, '2', '.', '.', 'N', '1', 'A', 'B', 'C', 0x15, 'H', '1', '0'};   // no STX / suffix
        const IridiumSbd s2 = iridiumParseSbd(none.data, true);
        CHECK(s2.valid && s2.acars.valid && s2.acars.text.empty() && s2.acars.crc == 0, "block without text");
        CHECK(iridiumAcarsIngest(t, none, s2, 1) == IridiumAcarsOutcome::New && t.acars.size() == 1 && t.acars[0].text.empty(), "empty text block still listed");
        const IridiumSbd s3 = iridiumParseSbd({0x76, 0x08}, true);
        CHECK(!s3.valid && iridiumAcarsIngest(t, none, s3, 1) == IridiumAcarsOutcome::None, "two bytes");
        // a lost middle fragment: no packet, no message; a later complete packet still works
        IridiumAcarsBuild b; b.reg = "N3"; b.text = std::string(70, 'X');
        const auto pk = iridiumBuildSbdAcarsEx(b);
        IridiumIdaAssembler as;
        const auto lost = viaFrames(as, pk, true, 5.0, 1);
        CHECK(lost.empty(), "missing fragment: nothing assembled");
        IridiumFrame late = idaFrame({1, 2, 3}, 0, false);
        const auto expired = as.feed(late, true, 1626.2e6, 9.0, 1);
        bool sawIncomplete = false;
        for (auto& p : expired) if (!p.complete) sawIncomplete = true;
        CHECK(sawIncomplete, "the waiting packet is given up as incomplete");
        const auto ok = viaFrames(as, pk, true, 20.0);
        CHECK(ok.size() == 1 && ok[0].complete, "later packet fine");
    }
    // ---- duplicate retransmissions
    {
        IridiumAcarsBuild b; b.reg = "G-EUPT"; b.label = "5Z"; b.blockId = '1'; b.parity = true; b.crc = true; b.fromAircraft = true; b.type = 0x7609;
        b.seq = "M12A"; b.flight = "BA0123"; b.text = "ON BLOCK 1234";
        const auto pk = iridiumBuildSbdAcarsEx(b);
        IridiumTelemetry t;
        uint64_t s1 = 0, s2 = 0, s3 = 0;
        CHECK(ingest(t, pk, false, 100.0, &s1) == IridiumAcarsOutcome::New, "first");
        CHECK(ingest(t, pk, false, 110.0, &s2) == IridiumAcarsOutcome::Repeat && s2 == s1 && t.acars.size() == 1 && t.acars[0].repeats == 1 && t.acarsDuplicates == 1, "repeat in 10 s dropped");
        CHECK(t.acars[0].seq == "M12A" && t.acars[0].flight == "BA0123" && t.acars[0].text == "ON BLOCK 1234", "aircraft block fields '%s'", t.acars[0].text.c_str());
        CHECK(t.aircraft.size() == 1 && t.aircraft[0].messages == 1 && t.aircraft[0].flight == "BA0123", "repeat does not count as a message");
        // a different sequence number is another message
        IridiumAcarsBuild b2 = b; b2.seq = "M13A";
        CHECK(ingest(t, iridiumBuildSbdAcarsEx(b2), false, 120.0) == IridiumAcarsOutcome::New && t.acars.size() == 2, "other sequence is new");
        // the other direction is another message
        IridiumAcarsBuild b3 = b; b3.fromAircraft = false; b3.type = 0x7608;
        CHECK(ingest(t, iridiumBuildSbdAcarsEx(b3), true, 125.0) == IridiumAcarsOutcome::New, "other direction is new");
        // much later: sent again on purpose
        CHECK(ingest(t, pk, false, 100.0 + 400.0, &s3) == IridiumAcarsOutcome::New && s3 != s1, "after the window it is new");
    }
    // ---- blocks of one message joined (ETB then ETX)
    {
        IridiumAcarsBuild a; a.reg = "D-AIRA"; a.label = "H1"; a.blockId = '1'; a.more = true; a.text = "FIRST PART, ";
        IridiumAcarsBuild c = a; c.blockId = '2'; c.more = false; c.text = "SECOND PART";
        IridiumTelemetry t;
        CHECK(ingest(t, iridiumBuildSbdAcarsEx(a), true, 50.0) == IridiumAcarsOutcome::New && t.acars[0].more, "first block waits");
        CHECK(ingest(t, iridiumBuildSbdAcarsEx(c), true, 52.0) == IridiumAcarsOutcome::Joined && t.acars.size() == 1, "second block joins");
        CHECK(t.acars[0].text == "FIRST PART, SECOND PART" && t.acars[0].blocks == 2 && !t.acars[0].more, "joined '%s' blocks %d", t.acars[0].text.c_str(), t.acars[0].blocks);
        // a block of another aircraft in between does not join
        IridiumAcarsBuild d = a; d.reg = "D-AIRB"; d.text = "X";
        IridiumTelemetry t2;
        ingest(t2, iridiumBuildSbdAcarsEx(a), true, 50.0);
        ingest(t2, iridiumBuildSbdAcarsEx(d), true, 51.0);
        CHECK(ingest(t2, iridiumBuildSbdAcarsEx(c), true, 52.0) == IridiumAcarsOutcome::Joined && t2.acars.size() == 2 && t2.acars[0].text == "FIRST PART, SECOND PART", "joined to the right one");
        // too late: not joined
        IridiumTelemetry t3;
        ingest(t3, iridiumBuildSbdAcarsEx(a), true, 50.0);
        CHECK(ingest(t3, iridiumBuildSbdAcarsEx(c), true, 200.0) == IridiumAcarsOutcome::New && t3.acars.size() == 2, "late block is a message of its own");
    }
    // ---- registration formats
    {
        struct C { const char* raw; int kind; const char* norm; uint32_t icao; };
        const C cs[] = {{".N893QS", 1, "N893QS", 0}, {"N893QS.", 1, "N893QS", 0}, {"..A6EDA", 1, "A6EDA", 0}, {"A6-EDA", 1, "A6-EDA", 0}, {".4CA1B2", 2, "4CA1B2", 0x4CA1B2},
                        {"4ca1b2", 2, "4CA1B2", 0x4CA1B2}, {"ABCDEF.", 2, "ABCDEF", 0xABCDEF}, {"G-EUPT", 1, "G-EUPT", 0}, {".......", 0, "", 0}, {"", 0, "", 0},
                        {"N8?3Q", 1, "N83Q", 0}, {"!!!!!!!", 3, "!!!!!!!", 0}};
        for (const C& c : cs) {
            const IridiumReg r = iridiumAcarsReg(c.raw);
            CHECK(r.kind == c.kind && r.norm == c.norm && r.icao == c.icao, "reg '%s': kind %d norm '%s' icao %06x", c.raw, r.kind, r.norm.c_str(), r.icao);
        }
    }
    // ---- positions: only from the aircraft, and they reach the aircraft list
    {
        IridiumAcarsBuild b; b.reg = "N893QS"; b.label = "H1"; b.blockId = '0'; b.fromAircraft = true; b.type = 0x7609; b.flight = "UA0456";
        b.parity = true; b.crc = true; b.text = "POSN43312W123174,EASON,215754,370,";
        IridiumTelemetry t;
        CHECK(ingest(t, iridiumBuildSbdAcarsEx(b), false, 300.0) == IridiumAcarsOutcome::New, "position report");
        const auto& m = t.acars[0];
        CHECK(m.hasPos && std::fabs(m.lat - 43.52) < 0.01 && std::fabs(m.lon + 123.29) < 0.01 && m.hasAlt && m.altFt == 37000, "pos %.3f %.3f alt %d (%s)", m.lat, m.lon, m.altFt, m.posKind.c_str());
        CHECK(t.aircraft.size() == 1 && t.aircraft[0].hasPos && t.aircraft[0].positions == 1 && t.aircraft[0].track.size() == 1 && t.aircraft[0].flight == "UA0456", "aircraft has the position and flight");
        // a second, different report extends the track
        IridiumAcarsBuild b2 = b; b2.seq = "M02A"; b2.text = "POSN43500W123000,NEXTWP,215954,370,";
        ingest(t, iridiumBuildSbdAcarsEx(b2), false, 360.0);
        CHECK(t.aircraft[0].track.size() == 2 && t.aircraft[0].positions == 2 && std::fabs(t.aircraft[0].lat - 43.8333) < 0.01, "track grows: %zu", t.aircraft[0].track.size());
        // the same text sent from the ground (Iridium downlink) is no position
        IridiumAcarsBuild g = b; g.fromAircraft = false; g.type = 0x7608; g.reg = "N777XX";
        IridiumTelemetry t2;
        ingest(t2, iridiumBuildSbdAcarsEx(g), true, 5.0);
        CHECK(!t2.acars[0].hasPos && t2.aircraft.size() == 1 && !t2.aircraft[0].hasPos, "ground message gives no position");
    }
    // ---- an ICAO address and a tail become one aircraft once an ADS-C style report names both: here by the address showing up with a tail
    {
        IridiumTelemetry t;
        IridiumAcarsBuild h; h.reg = "4CA1B2"; h.label = "H1"; h.text = "HELLO";
        ingest(t, iridiumBuildSbdAcarsEx(h), true, 1.0);
        CHECK(t.aircraft.size() == 1 && t.aircraft[0].icao == 0x4CA1B2 && t.acars[0].regKind == 2 && t.acars[0].icao == 0x4CA1B2, "hex address kept as ICAO");
        IridiumAcarsBuild h2 = h; h2.text = "AGAIN";
        ingest(t, iridiumBuildSbdAcarsEx(h2), true, 20.0);
        CHECK(t.aircraft.size() == 1 && t.aircraft[0].messages == 2, "same address, one aircraft");
    }
    // ---- dump helpers
    {
        const std::vector<uint8_t> v = {0x01, 0x41, 0x7f};
        CHECK(iridiumHexDump(v) == "01 41 7f" && iridiumAsciiDump(v) == ".A." && iridiumHexBytes("0141ZZ") == std::vector<uint8_t>({0x01, 0x41}), "dump helpers");
        std::vector<uint8_t> big(300, 0x41);
        CHECK(iridiumHexDump(big, 4) == "41 41 41 41 ...", "hex dump cut");
    }
    return testSummary("iridium_acars");
}
