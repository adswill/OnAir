// Real ACARS messages from the tests of airframesio/acars-decoder-typescript (MIT, see THIRD_PARTY.md), generated: plugin, label, text, then the expected
// latitude, longitude, altitude (ft), origin, destination, flight ("" or NAN when that test does not state it).
{"Label_12_N_Space", "12", "N 42.150,W121.187,39000,161859, 109,.C-GWSO,1742", 42.15, -121.187, 39000, "", "", ""},
{"Label_12_N_Space", "12", "N 28.371,W 80.458,38000,170546, 100,.C-GVWJ,1736", 28.371, -80.458, 38000, "", "", ""},
{"Label_16_AUTPOS", "16", "283806/AUTPOS/LLD N400547 W0774954\015\012/ALT 12932/SAT ****\015\012/WND ******/TAT ****/TAS ****/CRZ ***\015\012/FOB 065120\015\012/DAT 260228/TIM 150742", 40.096, -77.832, 12932, "", "", "3806"},
{"Label_16_AUTPOS", "16", "289142/AUTPOS/LLD N395538 W0753341 \015\012/ALT 35000/SAT -057\015\012/WND 239065/TAT -027/TAS 476/CRZ 836\015\012/FOB 107600\015\012/DAT 260228/TIM 132714", 39.927, -75.561, 35000, "", "", "9142"},
{"Label_16_Honeywell", "16", "(2AAABN39211W 77144KTEBMMTO-/A(Z", 39.352, -77.24, NAN, "KTEB", "MMTO", ""},
{"Label_16_Honeywell", "16", "(2AAAAN37265W 78334-SSI  /O(Z", 37.442, -78.557, NAN, "", "", ""},
{"Label_16_Honeywell", "16", "(2AAABN37197W 78404-SLOJOGRONK/O(Z", 37.328, -78.673, NAN, "", "", ""},
{"Label_16_N_Space", "16", "N 44.203,W 86.546,31965,6, 290", 44.203, -86.546, 31965, "", "", ""},
{"Label_16_N_Space", "16", "N 28.177/W 96.055", 28.177, -96.055, NAN, "", "", ""},
{"Label_16_N_Space", "16", "N 44.988,W121.644,35940,6, 170", 44.988, -121.644, 35940, "", "", ""},
{"Label_1J_2J_FTX", "1J", "FTX/ID50007B,RCH4086,ABB02R70E037/MR6,/FX4 QTR PHILLY UP 37-6307A", NAN, NAN, NAN, "", "", "RCH4086"},
{"Label_1J_2J_FTX", "1J", "M74AMC4086FTX/ID50007B,RCH4086,ABB02R70E037/DC10022025,011728/MR049,/FXGOOD EVENING PLEASE PASS US THE SUPER BOWL SCORE WHEN ABLE. THANK YOU/FB1791/VR0328D70", NAN, NAN, NAN, "", "", "RCH4086"},
{"Label_1L_070", "1L", "000000070LOWW,KEWR,0932,1744,N 49.223,E 12.038,0659", 49.223, 12.038, NAN, "LOWW", "KEWR", ""},
{"Label_1L_3-line", "1L", "00018213200/GS 411500/DEP MDPC/DES CYYZ/ETA 0120/GW 479/ALT 39002\015\012CAS 229/SAT - 59.0/FN SWG9040/TFQ 48/DAY 22OCT24/UTC 002714\015\012LON W 78.289/LAT N 39.556/WD  20/WS  13", 39.556, -78.289, 39002, "MDPC", "CYYZ", "SWG9040"},
{"Label_1L_3-line", "1L", "00086213200/GS 497000/DEP CYUL/DES MDPC/ETA 1705/GW 700/ALT 37002\015\012CAS/SAT   15.0/FN SWG4426/TFQ 111/DAY 26SEP24/UTC 135139\015\012LON MMMM.MMM/LAT MMMM.MMM/WD ---/WS ---", NAN, NAN, 37002, "CYUL", "MDPC", "SWG4426"},
{"Label_1L_660", "1L", "000000660N50442E005566,100444359SOG-06 ,,--- 21-,83617441", 50.736666666666665, 5.943333333333333, 35900, "", "", ""},
{"Label_1L_Slash", "1L", "+ 39.126/- 77.358/UTC 085208/FOB   8.2/ALT  3997/CAS  239/ETA 0903", 39.126, -77.358, 3997, "", "", ""},
{"Label_1M_Slash", "1M", "/BA0843/ETA01/230822/LDSP/EGLL/EGSS/2JK0\0121940/EGLL27L/10", NAN, NAN, NAN, "LDSP", "EGLL", "BA0843"},
{"Label_20_POS", "20", "POSN38160W077075,,211733,360,OTT,212041,,N42,19689,40,544", 38.16, -77.075, NAN, "", "", ""},
{"Label_20_POS", "20", "POSN38160W077075,,211733,360,OTT", 38.16, -77.075, NAN, "", "", ""},
{"Label_22_OFF", "22", "OFF01YX3661/25251712KIADKPWM171207  92", NAN, NAN, NAN, "KIAD", "KPWM", "YX3661"},
{"Label_22_OFF", "22", "OFF02XA0000/N38568 W077261251152KIADEPRZ1152****1958", 38.946666666666665, -77.435, NAN, "KIAD", "EPRZ", ""},
{"Label_22_OFF", "22", "OFF02\015\012KBWI,KIND,1237,18.4", NAN, NAN, NAN, "KBWI", "KIND", ""},
{"Label_22_POS", "22", "N 370824W 760010,-------,194936,30418, ,      , ,M 42,27335  42, 107,", 37.0824, -76.001, 30418, "", "", ""},
{"Label_24_Slash", "24", "/241710/1021/04WM/34962/N53.13/E001.33/3374/1056/", 53.13, 1.33, 34962, "", "", "04WM"},
{"Label_2A_SUM", "2A", "SUM/ID53147T,RCH140,/DC03032026,213916/MR7,/SM031612,420,032139,031623,416,031631,413,032130,212,032139,209/VR329519", NAN, NAN, NAN, "", "", "RCH140"},
{"Label_2A_SUM", "2A", "M90AMC2010SUM/ID70044B,RCH2010,PVZF504QP059/DC04032026,225050/MR196,/SM041038,3004,042250,041047,3000,041055,2985,042245,0526,042250,0521/VR0320E8B", NAN, NAN, NAN, "", "", "RCH2010"},
{"Label_2P_POS", "2P", "M80AMC4086POS/ID50007B,RCH4086,ABB02R70E037/DC10022025,051804/MR103,/ET090738/PSN56012W013273,051804,350,,,,,084081,/CG,,/FB0857/VR0322B89", 56.02, -13.455, 35000, "", "", "RCH4086"},
{"Label_30_Slash_EA", "30", "/EA1719/DSKSFO/SK23", NAN, NAN, NAN, "", "KSFO", ""},
{"Label_44_ETA", "44", "00ETA03,N38241W081357,330,KBNA,KBWI,1107,0123,0208,008.1", 38.401666666666664, -81.595, 33000, "KBNA", "KBWI", ""},
{"Label_44_ETA", "44", "00ETA03,N38241W081357,330,KBNA,KBWI,1107,ABCD,0208,008.1", NAN, NAN, NAN, "KBNA", "KBWI", ""},
{"Label_44_IN", "44", "IN01,N33528W084181,KCLT,KPDK,1106,0045,---.-", 33.88, -84.30166666666666, NAN, "KCLT", "KPDK", ""},
{"Label_44_IN", "44", "IN02,N38338W121179,KMHR,KPDX,0806,2355,005.1", 38.56333333333333, -121.29833333333333, NAN, "KMHR", "KPDX", ""},
{"Label_44_OFF", "44", "OFF02,N39247W077226,KFDK,KSNA,1106,2124,0248,011.1", 39.41166666666667, -77.37666666666667, NAN, "KFDK", "KSNA", ""},
{"Label_44_ON", "44", "ON01,N33522W084181,KCLT,KPDK,1106,004023,---.-,", 33.87, -84.30166666666666, NAN, "KCLT", "KPDK", ""},
{"Label_44_ON", "44", "ON02,N38333W121178,KRNO,KMHR,0806,2350,005.2", 38.555, -121.29666666666667, NAN, "KRNO", "KMHR", ""},
{"Label_44_Slash", "44", " /FB 0160/AD KORH/N 38.655,W 75.325,JBU2834,INA03,KORH,2043", 38.655, -75.325, NAN, "", "KORH", "JBU2834"},
{"Label_44_Slash", "44", " /FB ----/AD KTPA/N 27.971,W 82.558,JBU91,FLS03,KTPA,53988,53988,----,1943,1943,1,1L,VIS1L,0,2,0,,", 27.971, -82.558, NAN, "", "KTPA", "JBU91"},
{"Label_4J_POS", "4J", "POS/ID91459S,BANKR31,/DC03032024,142813/MR64,0/ET31539/PSN39277W077359,142800,240,N39300W077110,031430,N38560W077150,M28,27619,MT370/CG311,160,350/FB732/VR329071", 39.462, -77.598, 24000, "", "", "BANKR31"},
{"Label_58", "58", "OG0704/06/230942/N39.214/W76.106/22683/N/", 39.214, -76.106, 22683, "", "", "OG0704"},
{"Label_5Z_Slash", "5Z", "/B3 TO DATA REQ    / KIAH KBOS 14 152532 R4R /---- BOPT/OFF C0.000/1 LNO  G1600", NAN, NAN, NAN, "KIAH", "KBOS", ""},
{"Label_5Z_Slash", "5Z", "/ET EXP TIME       / KEWR KBNA 20 122559/EON 1336 AUTO", NAN, NAN, NAN, "KEWR", "KBNA", ""},
{"Label_5Z_Slash", "5Z", "/C3 GATE REQ       / KBNA KEWR 22 115400 0554 ---- ---- ---- ----", NAN, NAN, NAN, "KBNA", "KEWR", ""},
{"Label_80", "80", "3N01 POSRPT 5891/04 KIAH/MMGL .XA-VOI\015\012/POS N29395W095133/ALT +15608/MCH 558/FOB 0100/ETA 0410", 29.395, -95.133, 15608, "KIAH", "MMGL", "5891"},
{"Label_80", "80", "3N01 POSRPT 0581/27 KIAD/MSLP .N962AV/04H 11:02\015\012/NWYP CIGAR /HDG 233/MCH 782\015\012/POS N3539.2W07937.2/FL 360/TAS 445/SAT -060\015\012/SWND 110/DWND 306/FOB N009414/ETA 14:26.0 ", 35.391999999999996, -79.372, 36000, "KIAD", "MSLP", ""},
{"Label_80", "80", "/FB 0105/AD KCHS/N3950.1,W07548.3,3P01 POSRPT  0267/20 KBOS/KCHS .N3275J\012/UTC 143605/POS N3950.1 W07548.3/ALT 38007\012/SPD 334/FOB 0105/ETA 1622", 39.501, -75.483, 38007, "KBOS", "KCHS", "0267"},
{"Label_80", "80", "3C01 POS N39328W077307  ,,143700,               ,      ,               ,P47,124,0069", 39.328, -77.307, NAN, "", "", ""},
{"Label_80", "80", "3M01 OPNORM 0411/20 KEWR/MMMX .XA-MAT ", NAN, NAN, NAN, "KEWR", "MMMX", "0411"},
{"Label_80", "80", "3701 INRANG 3451/20 KSBD/KBWI .N613AZ\012/ETA 1254/ERT      ", NAN, NAN, NAN, "KSBD", "KBWI", "3451"},
{"Label_83", "83", "KLAX,KEWR,220103, 40.53,- 74.47, 3836,212, 140.0, 19700", 40.53, -74.47, 3836, "KLAX", "KEWR", ""},
{"Label_83", "83", "4DH3 ETAT2  0907/22 ENGM/KEWR .LN-RKO\015\012/ETA 1641", NAN, NAN, NAN, "ENGM", "KEWR", ""},
{"Label_83", "83", "001PR22035539N4038.6W07427.80292500008", 40.64333333333333, -74.46333333333334, 2925, "", "", ""},
{"Label_8E", "8E", "EGSS,1618", NAN, NAN, NAN, "", "EGSS", ""},
{"Label_H1_76401", "H1", "76401\015\01202E23KDJTKBWI\015\012N35551W07767100084099M050276030G1801230030YY,\015\012", NAN, NAN, NAN, "KDJT", "KBWI", ""},
{"Label_H1_76401", "H1", "76401\015\01202E23KBWIKBDL\015\012N39831W07515900082500M032334018B000025003005Z\015\012", NAN, NAN, NAN, "KBWI", "KBDL", ""},
{"Label_H1_76401", "H1", "76401\015\01202E23KPHXKBUR\015\012N34550W11842100030787M001223021G000025::Q030;\015\012N34499W11847100040641P003227022G000025::2HGMY\015\012N34443W11851500050596P004225020G000025::B0YY,\015\012N34386W11855900060596P004227017G000025::B0G", NAN, NAN, NAN, "KPHX", "KBUR", ""},
{"Label_H1_FPN", "H1", "FPN/FNAAL1956/RP:DA:KPHL:AA:KPHX:CR:PHLPHX61:R:27L(26O):D:PHL3:A:EAGUL6.ZUN:AP:ILS26..AIR,N40010W080490.J110.BOWRR..VLA,N39056W089097..STL,N38516W090289..GIBSN,N38430W092244..TYGER,N38410W094050..GCK,N37551W100435..DIXAN,N36169W105573..ZUN,N34579W109093293B", NAN, NAN, NAN, "", "", "AAL1956"},
{"Label_H1_FPN", "H1", "FPN/FNUAL1187/RP:DA:KSFO:AA:KPHX:F:KAYEX,N36292W120569..LOSHN,N35509W120000..BOILE,N34253W118016..BLH,N33358W114457DDFB", NAN, NAN, NAN, "", "", "UAL1187"},
{"Label_H1_FPN", "H1", "FPN/SN2125/FNQFA780/RI:DA:YPPH:CR:PERMEL001:AA:YMML..MEMUP,S33451E\015\012120525.Y53.WENDY0560", NAN, NAN, NAN, "", "", "QFA780"},
{"Label_H1_FPN", "H1", "FPN/RP:DA:KSEA:AA:KPHX:D:SUMMA2.SUMMA:F:SUMMA,N46371W121593..LTJ,N45428W121061..IMB,N44389W119427.Q35..CORKR,N36050W112240..TENTS,N35295W112271:A:BRUSR1.TENTS/FNFFT17245D16", NAN, NAN, NAN, "", "", "FFT1724"},
{"Label_H1_FPN", "H1", "F37AKL0767#M1BFPN/TS232008,022324/RP:DA:TNCA:AA:TNCB:R:11O:D:ADRI1F..IRLEP.A574..PJG:AP:RNV10(10O)/PR,,110,,183,7,13,,M7,25,,,P30,M40,36090,13,3455,300/DTTNCB,10O,119,23440847C0", NAN, NAN, NAN, "TNCA", "TNCB", "KL0767"},
{"Label_H1_FPN", "H1", "FPN/ID88194A,RCH857,PMZM107QP021/MR2,/RM:AA:FJDG:F:DOH.N300..NOLSU.P307..SETSI.P307..PARAR..N20000E063000..RIGLO.L516..ELKEL.L516..BUMMR/WP,,,,E3E9", NAN, NAN, NAN, "", "FJDG", "RCH857"},
{"Label_H1_FPN", "H1", "FPN/ID80094S,RCH411,8JZ41NG3S048/MR3,5/RP:DA:KMCF:AA:LBSF:F:PIE..BRUTS.Q109.CAMJO.Q109.YURCK.Q97.PAACK.Q97.BLENO.Q97.FRIAR..TOPPS..FROSS..RIKAL..N53000W050000..N55000W040000..N56000W030000..N56000W020000..PIKIL..SOVED..MIMKU..MAC..BELOX.L603.DOLAS..NAVPI..MAVAS..SOGPO..TIVUN..ESAMA..OSBIT..KOMIB..SULUS.Z650.VEMUT..PEPIK..BERVA..ERGOM..TEGRI..OSTOV..GOL:V:CAMJO,301,AT3100,,:V:PAACK,282,AT3300,,:V:BLENO,258,AT3700,,:V:N53000W050000,256,AT3700,,:V:N55000W040000,260,AT3700,,:V:SOVED,303,AT2700,,:V:MIMKU,302,AT2700,,:V:DOLAS,290,AT2900,,:V:PEPIK,242,AT3700,,:V:BERVA,260,AT3700,,7147/WD,,,,C850", NAN, NAN, NAN, "KMCF", "LBSF", "RCH411"},
{"Label_H1_FTX", "H1", "FTX/ID23544S,HIFI21,7VZ007B1S276/MR2,/FXFYI .. TAF KSUX 021720Z 0218 0318 20017G28KT P6SM SKC FM022200 22012G18KT P6SM SKC .. PUTS YOUR CXWIND AT 26KT ON RWY 13 .. REDUCES TO 18KT AT 22Z4FEF", NAN, NAN, NAN, "", "", "HIFI21"},
{"Label_H1_INI", "H1", "INI/ID70045B,RCH2050,AJM363201271/MR2,000/AFKDOV,KBHM/TD271115,131545EE", NAN, NAN, NAN, "KDOV", "KBHM", "RCH2050"},
{"Label_H1_LDI", "H1", "LDI/RW27R,,,,,M160,1676,,,,202003,2,,,,P8,137147150,0,,M160,,146149150,P48,2,2.27L,,,,,M160,1676,,,,202003,2,,,,P8,137147150,0,,M160,,147150151,P52,2,2.35O,,,,,M160,1676,,,,202003,2,,,,P8,127133138,0,,,,,,3:KPHL,H1007,1036,1036,1036/CG225/SN69EAE8", NAN, NAN, NAN, "KPHL", "", ""},
{"Label_H1_M_POS", "H1", "M85AQF0073YSSY,KSFO,101621,- 4.9985,-169.9820,35003,290,  35.1, 44100,S05W169,S02W167,1645", -4.9985, -169.982, 35003, "YSSY", "KSFO", "QF0073"},
{"Label_H1_M_POS", "H1", "M87AQF0073YSSY,KSFO,101702,  0.7144,-166.0643,36000,282,  34.1, 40200,S00W166,N03W162,1739", 0.7144, -166.0643, 36000, "YSSY", "KSFO", "QF0073"},
{"Label_H1_M_POS", "H1", "M89AQF0073YSSY,KSFO,101819,  7.2016,-158.1146,37001,275,  33.5, 32700,N07W158,N11W153,1900", 7.2016, -158.1146, 37001, "", "", "QF0073"},
{"Label_H1_POS", "H1", "POSN43312W123174,EASON,215754,370,EBINY,220601,ELENN,M48,02216,185/TS215754,0921227A40", 43.52, -123.29, 37000, "", "", ""},
{"Label_H1_POS", "H1", "POSN45209W122550,PEGTY,220309,134,MINNE,220424,HISKU,M6,060013,269,366,355K,292K,730A5B", 45.348, -122.917, 13400, "", "", ""},
{"Label_H1_POS", "H1", "POSN43030W122406,IBALL,220516,380,AARON,220816,MOXEE,M47,0047,86/TS220516,092122BF64", 43.05, -122.677, 38000, "", "", ""},
{"Label_H1_POS", "H1", "POSN33225W079428,SCOOB,232933,340,ENEME,235712,FETAL,M42,003051,15857F6", 33.375, -79.713, 34000, "", "", ""},
{"Label_H1_POS", "H1", "POSN38531W078000,CSN-01,112309,310,CYN-02,114151,ACK,M40,26067,22479226", 38.885, -78.0, 31000, "", "", ""},
{"Label_H1_POS", "H1", "F37AMCLL93#M1BPOS/ID746026,,/DC03032024,173207/MR1,/ET031846/PSN42579W108090,173207,320,WAIDE,031759,WEDAK,M49,267070,T468/CG264,110,360/FB742/VR324E17", 42.965, -108.15, 32000, "", "", ""},
{"Label_H1_POS", "H1", "POSN51194E004527,EH556,104241,174,CIV,105208,MEDIL,M20,290016,191/RP:DA:EHEH:AA:LEIB..CIV.N872.MEDIL.UN872.KOVIN.UM728.RESMI.UN857.DISAK..DIRMO..ETAMO..ADEKA..MOKDI..MEN..BADAM..KANIG..KENAS.N855.POS/PR1496,150,370,191,,55,10,248028,M47,30,P19,P0/FHCIV,105208,273K,3226,175,M41,252027,450,N,221,62.MEDIL,105411,267K,3439,172,M44,250028,459,N,203,15.PITHI,105533,259K,3584,170,M47,249028,456,N,203,10.LESDO,105859,252K,3700,167,M47,248028,456,N,203,25.KOVIN,110153,252K,3700,164,M47,248028,456,N,203,21.DUCRA,110705,252K,3700,160,M47,248028,456,N,213,37.RESMI,111101,251K,3700,156,M47,248028,455,N,213,28.DEKOD,111325,251K,3700,154,M47,248028,455,N,192,17.DISAK,111438,251K,3700,153,M47,248028,454,N,172,9.DIRMO,112306,251K,3700,145,M47,248028,454,N,178,63.ETAMO,112514,250K,3700,143,M47,248028,453,N,158,16.ADEKA,113339,250K,3700,136,M47,248028,454,N,147,64.MOKDI,114139,251K,3700,129,M47,248028,454,N,181,59.MEN,114429,251K,3700,127,M47,248028,454,N,181,21.BADAM,114843,251K,3700,123,M47,248028,454,N,179,31.KANIG,120154,250K,3700,111,M47,248028,453,N,185,97.KENAS,121800,250K,3700,98,M47,248028,453,N,177,119.POS,122257,250K,3018,96,M45,248023,395,N,182,34.LEIB,124503,150K,2,89,P15,000000,161,N,231,103/DTLEIB,,89,124503,7353B2", NAN, NAN, 17400, "", "", ""},
{"Label_H1_POS", "H1", "/.POS/TS100316,210324/PSS35333W058220,,100316,250,S37131W059150,101916,S39387W060377,M23,27282,241,780,MANUAL,0,813E711", -35.555, -58.367, 25000, "", "", ""},
{"Label_H1_POS", "H1", "POSN40281W080542,DILNE,021507,158,TVTRN,56,022414,ROD,M8,276031,366K,290K,1594,370,KPIT,KLAS,,182,062759,1633,73/PR1594,238,340,370,,44,9,287060,M51,180,P0,P0/RI:DA:KPIT:AA:KLAS..TVTRN..ROD..DONVE..SPI..AGENT..KK57E..DUUZE..KD51W..FLOOD..KD48S..TYEGR:A:CHOWW4.TYEGR:F:WOLPH48AF", NAN, NAN, 15800, "KPIT", "", ""},
{"Label_H1_POS", "H1", "POSN42218W071010,,111128,0,520,0,,NHANT,P17,,100K,045K,,150,KBOS,KBWI,33L,,,,73/PR,222,,150,,,,,,180,P0,P0/RI:DA:KBOS:AA:KBWI:R:04R(33L):D:SSOXS7:F:SSOXS..DISCO..SSOXS.Q167.ZIZZI..KNUKK..ATR..LAFLN:A:MIIDY4.LAFLN:F:JANNS:AP:ILS 33L.JANNS:F:YANNIACF9", NAN, NAN, 0, "", "", ""},
{"Label_H1_POS", "H1", "POSN40281W080542,DILNE,021507,158,TVTRN,56,022414,ROD,M8,276031,366K,290K,1594,370,KPIT,KLAS,,182,062759,1633,73/PR1594,238,340,370,,44,9,287060,M51,180,P0/RI:DA:KPIT:AA:KLAS..TVTRN..ROD..DONVE..SPI..AGENT..KK57E..DUUZE..KD51W..FLOOD..KD48S..TYEGR:A:CHOWW4.TYEGR:F:WOLPH167E", NAN, NAN, 15800, "", "", ""},
{"Label_H1_PRF", "H1", "PRF/TR,246,1,0,P10,102936,P8,P44,130131137,0,169,KDCA,KMCO,01O,1311,1142,SWA1500,328005,1086,1086,44136B", NAN, NAN, NAN, "KDCA", "KMCO", "SWA1500"},
{"Label_H1_PRG", "H1", "PRG/FNEXS67TP/DTEGPF,23O,67,214405,298262", NAN, NAN, NAN, "", "", "EXS67TP"},
{"Label_H1_PRG", "H1", "PRG/LR,000855,SWA786,KBWI,KBOS,04R,25,1285,1192,93,1284,P4,001004,8,141K,D713,000950,2,291483", NAN, NAN, NAN, "", "", "SWA786"},
{"Label_H1_PRG", "H1", "#M1BPRG/DTEKCH,22L,69,141204,042/FNSAS87W/TS132645,2402246784", NAN, NAN, NAN, "", "", "SAS87W"},
{"Label_H1_PRG", "H1", "PRG/DT,KMDW,31R,62,031854,524,N38584W077333,171,732B3C", 38.584, -77.333, NAN, "", "KMDW", ""},
{"Label_H1_Paren", "H1", "(POS-KLM296  -3911N07600W/234212 F250\015\012RMK/FUEL  37.0 M0.69)", 39.183, -76.0, 25000, "", "", "KLM296"},
{"Label_H1_REQ", "H1", "#MDREQPOS/ID55150A,RCH892,LVZF1185C049/MR1,/AU39310", NAN, NAN, NAN, "", "", "RCH892"},
{"Label_H1_Slash", "H1", "/HDQDLUA.POSN38332W080082,RONZZ,135753,320,LEVII,140454,WISTA,M45,20967,194/GAHDQDLUA/CA/TS135753,1411240721", 38.553, -80.137, 32000, "", "", ""},
{"Label_H1_StarPOS", "H1", "*POS10300950N3954W07759363312045802M5230175", 39.9, -77.98333333333333, 36331, "", "", ""},
{"Label_HX", "HX", "RA FMT LOCATION N4009.6 W07540.8", 40.16, -75.68, NAN, "", "", ""},
{"Label_HX", "HX", "RA FMT 43 GSP B02", NAN, NAN, NAN, "GSP", "", ""},
{"Label_QQ", "QQ", "KSDLKLAS0025\015\012001FE09002543N3336.6W11155.90281750042", 33.61, -111.93166666666667, NAN, "KSDL", "KLAS", ""},
{"Label_QQ", "QQ", "KLGBKLAX0004\015\012001FE07000444N3349.8W11810.1---0200009", 33.83, -118.16833333333334, NAN, "KLGB", "KLAX", ""},
{"Label_QQ", "QQ", "CYOWKMEM0058/OFFRPT/090155", NAN, NAN, NAN, "CYOW", "KMEM", ""},
