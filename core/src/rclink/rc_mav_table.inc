// Generated from the MAVLink message definitions (mavlink/mavlink standard.xml, common.xml, minimal.xml; ArduPilot/mavlink ardupilotmega.xml, MIT licence):
// message id, CRC_EXTRA computed with the pymavlink algorithm, name.
{0,50,"HEARTBEAT"},
{1,124,"SYS_STATUS"},
{2,137,"SYSTEM_TIME"},
{4,237,"PING"},
{5,217,"CHANGE_OPERATOR_CONTROL"},
{6,104,"CHANGE_OPERATOR_CONTROL_ACK"},
{7,119,"AUTH_KEY"},
{8,117,"LINK_NODE_STATUS"},
{11,89,"SET_MODE"},
{20,214,"PARAM_REQUEST_READ"},
{21,159,"PARAM_REQUEST_LIST"},
{22,220,"PARAM_VALUE"},
{23,168,"PARAM_SET"},
{24,24,"GPS_RAW_INT"},
{25,23,"GPS_STATUS"},
{26,170,"SCALED_IMU"},
{27,144,"RAW_IMU"},
{28,67,"RAW_PRESSURE"},
{29,115,"SCALED_PRESSURE"},
{30,39,"ATTITUDE"},
{31,246,"ATTITUDE_QUATERNION"},
{32,185,"LOCAL_POSITION_NED"},
{33,104,"GLOBAL_POSITION_INT"},
{34,237,"RC_CHANNELS_SCALED"},
{35,244,"RC_CHANNELS_RAW"},
{36,222,"SERVO_OUTPUT_RAW"},
{37,212,"MISSION_REQUEST_PARTIAL_LIST"},
{38,9,"MISSION_WRITE_PARTIAL_LIST"},
{39,254,"MISSION_ITEM"},
{40,230,"MISSION_REQUEST"},
{41,28,"MISSION_SET_CURRENT"},
{42,28,"MISSION_CURRENT"},
{43,132,"MISSION_REQUEST_LIST"},
{44,221,"MISSION_COUNT"},
{45,232,"MISSION_CLEAR_ALL"},
{46,11,"MISSION_ITEM_REACHED"},
{47,153,"MISSION_ACK"},
{48,41,"SET_GPS_GLOBAL_ORIGIN"},
{49,39,"GPS_GLOBAL_ORIGIN"},
{50,78,"PARAM_MAP_RC"},
{51,196,"MISSION_REQUEST_INT"},
{54,15,"SAFETY_SET_ALLOWED_AREA"},
{55,3,"SAFETY_ALLOWED_AREA"},
{61,167,"ATTITUDE_QUATERNION_COV"},
{62,183,"NAV_CONTROLLER_OUTPUT"},
{63,119,"GLOBAL_POSITION_INT_COV"},
{64,191,"LOCAL_POSITION_NED_COV"},
{65,118,"RC_CHANNELS"},
{66,148,"REQUEST_DATA_STREAM"},
{67,21,"DATA_STREAM"},
{69,243,"MANUAL_CONTROL"},
{70,124,"RC_CHANNELS_OVERRIDE"},
{73,38,"MISSION_ITEM_INT"},
{74,20,"VFR_HUD"},
{75,158,"COMMAND_INT"},
{76,152,"COMMAND_LONG"},
{77,143,"COMMAND_ACK"},
{80,14,"COMMAND_CANCEL"},
{81,106,"MANUAL_SETPOINT"},
{82,49,"SET_ATTITUDE_TARGET"},
{83,22,"ATTITUDE_TARGET"},
{84,143,"SET_POSITION_TARGET_LOCAL_NED"},
{85,140,"POSITION_TARGET_LOCAL_NED"},
{86,5,"SET_POSITION_TARGET_GLOBAL_INT"},
{87,150,"POSITION_TARGET_GLOBAL_INT"},
{89,231,"LOCAL_POSITION_NED_SYSTEM_GLOBAL_OFFSET"},
{90,183,"HIL_STATE"},
{91,63,"HIL_CONTROLS"},
{92,54,"HIL_RC_INPUTS_RAW"},
{93,47,"HIL_ACTUATOR_CONTROLS"},
{100,175,"OPTICAL_FLOW"},
{101,102,"GLOBAL_VISION_POSITION_ESTIMATE"},
{102,158,"VISION_POSITION_ESTIMATE"},
{103,208,"VISION_SPEED_ESTIMATE"},
{104,56,"VICON_POSITION_ESTIMATE"},
{105,93,"HIGHRES_IMU"},
{106,138,"OPTICAL_FLOW_RAD"},
{107,108,"HIL_SENSOR"},
{108,32,"SIM_STATE"},
{109,185,"RADIO_STATUS"},
{110,84,"FILE_TRANSFER_PROTOCOL"},
{111,34,"TIMESYNC"},
{112,174,"CAMERA_TRIGGER"},
{113,124,"HIL_GPS"},
{114,237,"HIL_OPTICAL_FLOW"},
{115,4,"HIL_STATE_QUATERNION"},
{116,76,"SCALED_IMU2"},
{117,128,"LOG_REQUEST_LIST"},
{118,56,"LOG_ENTRY"},
{119,116,"LOG_REQUEST_DATA"},
{120,134,"LOG_DATA"},
{121,237,"LOG_ERASE"},
{122,203,"LOG_REQUEST_END"},
{123,250,"GPS_INJECT_DATA"},
{124,87,"GPS2_RAW"},
{125,203,"POWER_STATUS"},
{126,220,"SERIAL_CONTROL"},
{127,25,"GPS_RTK"},
{128,226,"GPS2_RTK"},
{129,46,"SCALED_IMU3"},
{130,29,"DATA_TRANSMISSION_HANDSHAKE"},
{131,223,"ENCAPSULATED_DATA"},
{132,85,"DISTANCE_SENSOR"},
{133,6,"TERRAIN_REQUEST"},
{134,229,"TERRAIN_DATA"},
{135,203,"TERRAIN_CHECK"},
{136,1,"TERRAIN_REPORT"},
{137,195,"SCALED_PRESSURE2"},
{138,109,"ATT_POS_MOCAP"},
{139,168,"SET_ACTUATOR_CONTROL_TARGET"},
{140,181,"ACTUATOR_CONTROL_TARGET"},
{141,47,"ALTITUDE"},
{142,72,"RESOURCE_REQUEST"},
{143,131,"SCALED_PRESSURE3"},
{144,127,"FOLLOW_TARGET"},
{146,103,"CONTROL_SYSTEM_STATE"},
{147,154,"BATTERY_STATUS"},
{148,178,"AUTOPILOT_VERSION"},
{149,200,"LANDING_TARGET"},
{150,134,"SENSOR_OFFSETS"},
{151,219,"SET_MAG_OFFSETS"},
{152,208,"MEMINFO"},
{153,188,"AP_ADC"},
{154,84,"DIGICAM_CONFIGURE"},
{155,22,"DIGICAM_CONTROL"},
{156,19,"MOUNT_CONFIGURE"},
{157,21,"MOUNT_CONTROL"},
{158,134,"MOUNT_STATUS"},
{160,78,"FENCE_POINT"},
{161,68,"FENCE_FETCH_POINT"},
{162,189,"FENCE_STATUS"},
{163,127,"AHRS"},
{164,154,"SIMSTATE"},
{165,21,"HWSTATUS"},
{166,21,"RADIO"},
{167,144,"LIMITS_STATUS"},
{168,1,"WIND"},
{169,234,"DATA16"},
{170,73,"DATA32"},
{171,181,"DATA64"},
{172,22,"DATA96"},
{173,83,"RANGEFINDER"},
{174,167,"AIRSPEED_AUTOCAL"},
{175,138,"RALLY_POINT"},
{176,234,"RALLY_FETCH_POINT"},
{177,240,"COMPASSMOT_STATUS"},
{178,47,"AHRS2"},
{179,189,"CAMERA_STATUS"},
{180,52,"CAMERA_FEEDBACK"},
{181,174,"BATTERY2"},
{182,229,"AHRS3"},
{183,85,"AUTOPILOT_VERSION_REQUEST"},
{184,159,"REMOTE_LOG_DATA_BLOCK"},
{185,186,"REMOTE_LOG_BLOCK_STATUS"},
{186,72,"LED_CONTROL"},
{191,92,"MAG_CAL_PROGRESS"},
{192,36,"MAG_CAL_REPORT"},
{193,71,"EKF_STATUS_REPORT"},
{194,98,"PID_TUNING"},
{195,120,"DEEPSTALL"},
{200,134,"GIMBAL_REPORT"},
{201,205,"GIMBAL_CONTROL"},
{214,69,"GIMBAL_TORQUE_CMD_REPORT"},
{215,101,"GOPRO_HEARTBEAT"},
{216,50,"GOPRO_GET_REQUEST"},
{217,202,"GOPRO_GET_RESPONSE"},
{218,17,"GOPRO_SET_REQUEST"},
{219,162,"GOPRO_SET_RESPONSE"},
{225,208,"EFI_STATUS"},
{226,207,"RPM"},
{230,163,"ESTIMATOR_STATUS"},
{231,105,"WIND_COV"},
{232,151,"GPS_INPUT"},
{233,35,"GPS_RTCM_DATA"},
{234,150,"HIGH_LATENCY"},
{235,179,"HIGH_LATENCY2"},
{241,90,"VIBRATION"},
{242,104,"HOME_POSITION"},
{243,85,"SET_HOME_POSITION"},
{244,95,"MESSAGE_INTERVAL"},
{245,130,"EXTENDED_SYS_STATE"},
{246,184,"ADSB_VEHICLE"},
{247,81,"COLLISION"},
{248,8,"V2_EXTENSION"},
{249,204,"MEMORY_VECT"},
{250,49,"DEBUG_VECT"},
{251,170,"NAMED_VALUE_FLOAT"},
{252,44,"NAMED_VALUE_INT"},
{253,83,"STATUSTEXT"},
{254,46,"DEBUG"},
{256,71,"SETUP_SIGNING"},
{257,131,"BUTTON_CHANGE"},
{258,187,"PLAY_TUNE"},
{259,92,"CAMERA_INFORMATION"},
{260,146,"CAMERA_SETTINGS"},
{261,179,"STORAGE_INFORMATION"},
{262,12,"CAMERA_CAPTURE_STATUS"},
{263,133,"CAMERA_IMAGE_CAPTURED"},
{264,49,"FLIGHT_INFORMATION"},
{265,26,"MOUNT_ORIENTATION"},
{266,193,"LOGGING_DATA"},
{267,35,"LOGGING_DATA_ACKED"},
{268,14,"LOGGING_ACK"},
{269,109,"VIDEO_STREAM_INFORMATION"},
{270,59,"VIDEO_STREAM_STATUS"},
{271,22,"CAMERA_FOV_STATUS"},
{275,126,"CAMERA_TRACKING_IMAGE_STATUS"},
{276,18,"CAMERA_TRACKING_GEO_STATUS"},
{277,62,"CAMERA_THERMAL_RANGE"},
{280,70,"GIMBAL_MANAGER_INFORMATION"},
{281,48,"GIMBAL_MANAGER_STATUS"},
{282,123,"GIMBAL_MANAGER_SET_ATTITUDE"},
{283,74,"GIMBAL_DEVICE_INFORMATION"},
{284,99,"GIMBAL_DEVICE_SET_ATTITUDE"},
{285,137,"GIMBAL_DEVICE_ATTITUDE_STATUS"},
{286,210,"AUTOPILOT_STATE_FOR_GIMBAL_DEVICE"},
{287,1,"GIMBAL_MANAGER_SET_PITCHYAW"},
{288,20,"GIMBAL_MANAGER_SET_MANUAL_CONTROL"},
{290,251,"ESC_INFO"},
{291,10,"ESC_STATUS"},
{295,234,"AIRSPEED"},
{296,158,"GLOBAL_POSITION_SENSOR"},
{299,19,"WIFI_CONFIG_AP"},
{300,217,"PROTOCOL_VERSION"},
{301,243,"AIS_VESSEL"},
{310,28,"UAVCAN_NODE_STATUS"},
{311,95,"UAVCAN_NODE_INFO"},
{320,243,"PARAM_EXT_REQUEST_READ"},
{321,88,"PARAM_EXT_REQUEST_LIST"},
{322,243,"PARAM_EXT_VALUE"},
{323,78,"PARAM_EXT_SET"},
{324,132,"PARAM_EXT_ACK"},
{330,23,"OBSTACLE_DISTANCE"},
{331,91,"ODOMETRY"},
{332,236,"TRAJECTORY_REPRESENTATION_WAYPOINTS"},
{333,231,"TRAJECTORY_REPRESENTATION_BEZIER"},
{334,72,"CELLULAR_STATUS"},
{335,225,"ISBD_LINK_STATUS"},
{336,245,"CELLULAR_CONFIG"},
{339,199,"RAW_RPM"},
{340,99,"UTM_GLOBAL_POSITION"},
{345,209,"PARAM_ERROR"},
{350,232,"DEBUG_FLOAT_ARRAY"},
{360,11,"ORBIT_EXECUTION_STATUS"},
{361,93,"FIGURE_EIGHT_EXECUTION_STATUS"},
{370,75,"SMART_BATTERY_INFO"},
{371,10,"FUEL_STATUS"},
{372,26,"BATTERY_INFO"},
{373,117,"GENERATOR_STATUS"},
{375,251,"ACTUATOR_OUTPUT_STATUS"},
{376,199,"RELAY_STATUS"},
{380,232,"TIME_ESTIMATE_TO_TARGET"},
{385,147,"TUNNEL"},
{386,132,"CAN_FRAME"},
{387,4,"CANFD_FRAME"},
{388,8,"CAN_FILTER_MODIFY"},
{390,156,"ONBOARD_COMPUTER_STATUS"},
{395,0,"COMPONENT_INFORMATION"},
{396,50,"COMPONENT_INFORMATION_BASIC"},
{397,182,"COMPONENT_METADATA"},
{400,110,"PLAY_TUNE_V2"},
{401,183,"SUPPORTED_TUNES"},
{410,160,"EVENT"},
{411,106,"CURRENT_EVENT_SEQUENCE"},
{412,33,"REQUEST_EVENT"},
{413,77,"RESPONSE_EVENT_ERROR"},
{420,20,"RADIO_RC_CHANNELS"},
{435,134,"AVAILABLE_MODES"},
{436,193,"CURRENT_MODE"},
{437,30,"AVAILABLE_MODES_MONITOR"},
{440,66,"ILLUMINATOR_STATUS"},
{9000,113,"WHEEL_DISTANCE"},
{9005,117,"WINCH_STATUS"},
{11000,134,"DEVICE_OP_READ"},
{11001,15,"DEVICE_OP_READ_REPLY"},
{11002,234,"DEVICE_OP_WRITE"},
{11003,64,"DEVICE_OP_WRITE_REPLY"},
{11004,11,"SECURE_COMMAND"},
{11005,93,"SECURE_COMMAND_REPLY"},
{11010,46,"ADAP_TUNING"},
{11011,106,"VISION_POSITION_DELTA"},
{11020,205,"AOA_SSA"},
{11030,144,"ESC_TELEMETRY_1_TO_4"},
{11031,133,"ESC_TELEMETRY_5_TO_8"},
{11032,85,"ESC_TELEMETRY_9_TO_12"},
{11033,195,"OSD_PARAM_CONFIG"},
{11034,79,"OSD_PARAM_CONFIG_REPLY"},
{11035,128,"OSD_PARAM_SHOW_CONFIG"},
{11036,177,"OSD_PARAM_SHOW_CONFIG_REPLY"},
{11037,130,"OBSTACLE_DISTANCE_3D"},
{11038,47,"WATER_DEPTH"},
{11039,142,"MCU_STATUS"},
{11040,132,"ESC_TELEMETRY_13_TO_16"},
{11041,208,"ESC_TELEMETRY_17_TO_20"},
{11042,201,"ESC_TELEMETRY_21_TO_24"},
{11043,193,"ESC_TELEMETRY_25_TO_28"},
{11044,189,"ESC_TELEMETRY_29_TO_32"},
{11060,162,"NAMED_VALUE_STRING"},
{12900,114,"OPEN_DRONE_ID_BASIC_ID"},
{12901,254,"OPEN_DRONE_ID_LOCATION"},
{12902,140,"OPEN_DRONE_ID_AUTHENTICATION"},
{12903,249,"OPEN_DRONE_ID_SELF_ID"},
{12904,77,"OPEN_DRONE_ID_SYSTEM"},
{12905,49,"OPEN_DRONE_ID_OPERATOR_ID"},
{12915,94,"OPEN_DRONE_ID_MESSAGE_PACK"},
{12918,139,"OPEN_DRONE_ID_ARM_STATUS"},
{12919,7,"OPEN_DRONE_ID_SYSTEM_UPDATE"},
{12920,20,"HYGROMETER_SENSOR"},
